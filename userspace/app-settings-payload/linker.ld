ENTRY(_start)

SECTIONS {
  . = 0x0000008000000000;

  .text : {
    *(.text .text.*)
  }

  .rodata : {
    *(.rodata .rodata.*)
  }

  .data : {
    *(.data .data.*)
  }

  .bss : {
    *(.bss .bss.* COMMON)
  }
}
